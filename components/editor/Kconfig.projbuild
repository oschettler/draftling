## main/Kconfig.projbuild
```kconfig
menu "DRAFTLING Configuration"

choice DRAFTLING_HARDWARE_MODEL
    prompt "Hardware Model"
    default DRAFTLING_MODEL_M5STACK_PAPERS3
    help
        Select the target hardware platform for Draftling.

config DRAFTLING_MODEL_WAVESHARE_RLCD42
    bool "Waveshare ESP32-S3-RLCD-4.2"
    depends on IDF_TARGET_ESP32S3
    help
        Waveshare ESP32-S3-RLCD-4.2 board with 400x300 reflective LCD
        and GPIO18 deep-sleep wakeup button.

config DRAFTLING_MODEL_M5STACK_PAPERS3
    bool "M5Stack PaperS3"
    depends on IDF_TARGET_ESP32S3
    help
        M5Stack PaperS3 board with a 540x960 e-paper panel (ED047TC1
        family) driven by the ESP32-S3 LCD/I80 parallel peripheral.
        v1 uses a 1-bit black/white waveform with full-screen refresh
        only; partial refresh and grayscale are TODO.

config DRAFTLING_MODEL_WAVESHARE_TOUCH_LCD_349
    bool "Waveshare ESP32-S3-Touch-LCD-3.49 (AXS15231B, 3.49\" color LCD, 640x172)"
    depends on IDF_TARGET_ESP32S3
    help
        Waveshare ESP32-S3-Touch-LCD-3.49 development board: 3.49"
        IPS color LCD, 640x172, AXS15231B controller over QSPI.
        Touch input is not used (Draftling is keyboard-driven).

config DRAFTLING_MODEL_JC3248W535
    bool "Guition JC3248W535 (ESP32-S3, AXS15231B, 3.5\" color LCD, 480x320)"
    depends on IDF_TARGET_ESP32S3
    help
        Guition JC3248W535 development board: 3.5" IPS color LCD,
        480x320, AXS15231B controller over QSPI. Has an on-board
        AXS5106L capacitive touchscreen which Draftling uses as a
        secondary input (cursor, scroll, double-tap selection in
        the editor; tap-to-select in menus). This board has no
        user buttons besides the power switch; deep sleep is woken
        by the touchscreen.

config DRAFTLING_MODEL_LILYGO_TDISPLAY_S3
    bool "LilyGO T-Display-S3 (ST7789, 1.9\" color LCD, 320x170)"
    depends on IDF_TARGET_ESP32S3
    help
        LilyGO T-Display-S3 development board: 1.9" IPS color LCD,
        320x170, ST7789V controller over an 8-bit parallel (i80) bus
        driven by the ESP32-S3 LCD_CAM peripheral. Has an on-board
        battery monitor (GPIO4, 1:2 divider) and a BOOT button on
        GPIO0 used as the deep-sleep wake source. There is no
        on-board MicroSD slot; documents must be stored on an
        external SD wired to a free SPI bus.

endchoice

# ---- Derived: display category (driven by hardware-model choice) ----
#
# DRAFTLING_DISPLAY_COLOR is set automatically when the selected board
# has a color (RGB565) panel. Other code (the color-theme selection in
# the editor UI, lvgl_port render mode, etc.) keys off this symbol
# instead of testing every individual board id.
config DRAFTLING_DISPLAY_COLOR
    bool
    default y if DRAFTLING_MODEL_WAVESHARE_TOUCH_LCD_349
    default y if DRAFTLING_MODEL_JC3248W535
    default y if DRAFTLING_MODEL_LILYGO_TDISPLAY_S3
    default n

# DRAFTLING_DISPLAY_AXS15231B is set automatically when the selected
# board uses an AXS15231B QSPI controller. The display backend
# (components/display/display_axs15231b.cpp) is compiled in only for
# these boards.
config DRAFTLING_DISPLAY_AXS15231B
    bool
    default y if DRAFTLING_MODEL_WAVESHARE_TOUCH_LCD_349
    default y if DRAFTLING_MODEL_JC3248W535
    default n

# DRAFTLING_DISPLAY_ST7789 is set automatically when the selected
# board uses an ST7789 controller over an 8-bit parallel (i80) bus.
# The display backend (components/display/display_st7789.cpp) is
# compiled in only for these boards.
config DRAFTLING_DISPLAY_ST7789
    bool
    default y if DRAFTLING_MODEL_LILYGO_TDISPLAY_S3
    default n

# DRAFTLING_DISPLAY_RLCD is set automatically when the selected
# board uses a Waveshare reflective-LCD panel driven over SPI by
# the display_rlcd.cpp backend. Code that is specific to this
# backend (the file-level guard in display_rlcd.cpp, etc.) keys
# off this symbol instead of the model id.
config DRAFTLING_DISPLAY_RLCD
    bool
    default y if DRAFTLING_MODEL_WAVESHARE_RLCD42
    default n

# DRAFTLING_DISPLAY_EPD is set automatically when the selected
# board has an electronic-paper panel. Code that has to be aware
# of e-paper specifics (slow refresh, no blinking cursor, white-on-
# sleep wipe, partial-refresh interval, etc.) keys off this
# symbol instead of the model id so adding a new e-paper board
# does not require touching every consumer.
config DRAFTLING_DISPLAY_EPD
    bool
    default y if DRAFTLING_MODEL_M5STACK_PAPERS3
    default n

# DRAFTLING_DISPLAY_HAS_BACKLIGHT is set automatically on boards
# whose display backend drives a controllable backlight GPIO via
# LEDC PWM. The editor exposes a "Backlight" entry in the F1
# Settings menu (persisted in NVS) on these boards only.
config DRAFTLING_DISPLAY_HAS_BACKLIGHT
    bool
    default y if DRAFTLING_DISPLAY_AXS15231B
    default y if DRAFTLING_DISPLAY_ST7789
    default n

# DRAFTLING_BL_GPIO_BINARY tells the display backend to drive the
# backlight enable GPIO as a plain on/off digital output instead of
# an LEDC PWM channel. Kept available for future boards whose BL
# boost circuit does not tolerate LEDC PWM, but no current board
# defaults it to y. The polarity is taken from LCD_BL_ACTIVE_LOW in
# app_config.h (default 0 = active HIGH, 1 = active LOW), so the
# backend can drive the correct "on" / "off" level for either
# convention.
config DRAFTLING_BL_GPIO_BINARY
    bool
    default n

# DRAFTLING_HAS_BATTERY is set automatically on boards that wire
# the LiPo cell through a divider to an ADC pin (BATT_ADC_PIN >= 0
# in app_config.h). Used by the editor UI to decide whether to
# create the battery-percentage status-bar label and timer, instead
# of testing every model id individually.
config DRAFTLING_HAS_BATTERY
    bool
    default y if DRAFTLING_MODEL_WAVESHARE_RLCD42
    default y if DRAFTLING_MODEL_M5STACK_PAPERS3
    default y if DRAFTLING_MODEL_LILYGO_TDISPLAY_S3
    default n

# DRAFTLING_SD_SDMMC selects the on-chip SDMMC peripheral (1-bit
# mode) for SD card access. When unset, SD access goes through a
# generic SPI bus. Used by main.cpp's SD-init branch instead of
# testing per-board model ids.
config DRAFTLING_SD_SDMMC
    bool
    default y if DRAFTLING_MODEL_WAVESHARE_RLCD42
    default n

# DRAFTLING_WAKEUP_GPIO is the per-board RTC-capable GPIO used as
# the EXT0 deep-sleep wake source. Selected here so the standby
# component does not need to test individual model ids. The matching
# WAKEUP_GPIO_NUM macro in main/app_config.h is kept in lock-step
# for any code that includes app_config.h directly.
#
# When CONFIG_DRAFTLING_STANDBY_WAKE_ON_TOUCH is set the standby code
# arms EXT0 on CONFIG_DRAFTLING_TOUCH_INT_GPIO instead, regardless of
# this value.
config DRAFTLING_WAKEUP_GPIO
    int
    default 18 if DRAFTLING_MODEL_WAVESHARE_RLCD42
    default 0  if DRAFTLING_MODEL_M5STACK_PAPERS3
    default 0  if DRAFTLING_MODEL_WAVESHARE_TOUCH_LCD_349
    default 0  if DRAFTLING_MODEL_JC3248W535
    default 0  if DRAFTLING_MODEL_LILYGO_TDISPLAY_S3
    default 0

# ---- Touchscreen support ----
#
# DRAFTLING_TOUCHSCREEN enables an I2C touch-controller driver
# (currently only the AXS5106L on the Guition JC3248W535) and an
# LVGL pointer input device. When enabled, the editor accepts tap
# (move cursor), vertical swipe (scroll), and double-tap (select
# word) gestures; list screens (main menu, settings, file browser)
# accept tap-to-select on rows.
#
# The default is on for boards that have no user buttons besides the
# power switch (Guition JC3248W535).
config DRAFTLING_TOUCHSCREEN
    bool "Enable touchscreen input"
    default y if DRAFTLING_MODEL_JC3248W535
    default y if DRAFTLING_MODEL_M5STACK_PAPERS3
    default y if DRAFTLING_MODEL_WAVESHARE_TOUCH_LCD_349
    default n
    help
        Enable I2C touch-controller support and an LVGL pointer
        input device. The editor and list screens become
        touch-navigable in addition to the keyboard. Required on
        boards that have no user buttons.

# Touch controller silicon. Each model wires a different I2C chip
# (AXS5106L on the Guition JC3248W535, GT911 on the M5Stack
# PaperS3). The touchscreen component carries one driver per
# controller and dispatches at build time on these symbols.
#
# Both are non-prompted derived bools so the value tracks the
# hardware-model choice automatically (no stickiness in sdkconfig).
config DRAFTLING_TOUCH_AXS5106L
    bool
    depends on DRAFTLING_TOUCHSCREEN
    default y if DRAFTLING_MODEL_JC3248W535
    default y if DRAFTLING_MODEL_WAVESHARE_TOUCH_LCD_349
    default n
    help
        Allystar AXS5106L / AXS5106. Uses a fixed 8-byte read-request
        magic packet over I2C and returns one touch point. Default
        I2C address 0x3B.

config DRAFTLING_TOUCH_GT911
    bool
    depends on DRAFTLING_TOUCHSCREEN
    default y if DRAFTLING_MODEL_M5STACK_PAPERS3
    default n
    help
        Goodix GT911. Register-addressed protocol: 16-bit register
        address sent MSB-first, status byte at 0x814E, touch points
        at 0x814F+. Default I2C address 0x5D (0x14 as backup).

# Touchscreen INT GPIO. The touch controller pulses this line low
# on touch. Used by the LVGL pointer indev (the read_cb only polls
# I2C when INT is low to avoid bus noise on every LVGL tick) and,
# when CONFIG_DRAFTLING_STANDBY_WAKE_ON_TOUCH is set, as the EXT0
# deep-sleep wake source. Must be RTC-capable (GPIO0-21 on the
# ESP32-S3) for the wake-on-touch path to work.
#
# Non-prompted: derived from the hardware-model choice. Defaults
# verified for: Guition JC3248W535 (GPIO3, AXS5106L), M5Stack
# PaperS3 (GPIO48, GT911).
config DRAFTLING_TOUCH_INT_GPIO
    int
    depends on DRAFTLING_TOUCHSCREEN
    range -1 48
    default 3  if DRAFTLING_MODEL_JC3248W535
    default 48 if DRAFTLING_MODEL_M5STACK_PAPERS3
    default -1

# Touchscreen reset GPIO. The reset line is often tied to the LCD
# reset on combo touch+LCD boards; set to -1 to skip a software
# reset pulse during touchscreen_init.
#
# Non-prompted: derived from the hardware-model choice. On all
# currently-supported touch boards RST is tied to the LCD reset
# or a fixed pull-up, so the default is -1.
config DRAFTLING_TOUCH_RST_GPIO
    int
    depends on DRAFTLING_TOUCHSCREEN
    range -1 48
    default -1

# ---- Standby behavior ----
#
# By default the standby manager enters real ESP32 deep sleep on
# inactivity (or on "no keyboard within N seconds"). On boards with
# no buttons that can wake the chip, two alternative paths are
# available:
#
#   * DRAFTLING_STANDBY_DISPLAY_OFF -- keep the MCU running but blank
#     the display (clear framebuffer + backlight off + DISPOFF + SLPIN
#     on backends that support it). Wakes on any LVGL input event.
#
#   * DRAFTLING_STANDBY_WAKE_ON_TOUCH -- on deep sleep, arm EXT0 on
#     the touch INT pin instead of the BOOT button. Lets a touch wake
#     the device from real deep sleep. Requires DRAFTLING_TOUCHSCREEN
#     and a touch INT pin on an RTC-capable GPIO (GPIO0-21).
#
# When both are set the WAKE_ON_TOUCH path is preferred (it draws
# less power than keeping the MCU running). When neither is set the
# behavior is the existing BOOT-button EXT0 wake.
#
# On the Guition JC3248W535 (no user buttons) we default to deep
# sleep + wake-on-touch.
config DRAFTLING_STANDBY_DISPLAY_OFF
    bool "Standby: turn display off (keep MCU running) instead of deep sleep"
    default n
    help
        On standby, blank the display and put the panel into its
        low-power sleep mode instead of deep-sleeping the MCU.
        Any LVGL input event (touch, BLE keyboard) wakes the
        display.

        Use this on boards with no RTC-capable wake source (no
        BOOT button on an RTC GPIO and no touch INT on an RTC
        GPIO). It draws more power than deep sleep -- prefer
        DRAFTLING_STANDBY_WAKE_ON_TOUCH if you have a touch
        controller wired to an RTC GPIO.

config DRAFTLING_STANDBY_WAKE_ON_TOUCH
    bool "Standby: wake from deep sleep on touchscreen tap"
    depends on DRAFTLING_TOUCHSCREEN
    default y if DRAFTLING_MODEL_JC3248W535
    default n
    help
        On standby, enter real deep sleep and arm EXT0 on the
        touch INT line so any tap wakes the device. Requires
        DRAFTLING_TOUCH_INT_GPIO to be on an RTC-capable GPIO
        (0-21 on ESP32-S3).

        When this is set the touch INT pin overrides
        DRAFTLING_WAKEUP_GPIO as the deep-sleep wake source.

config DRAFTLING_DISPLAY_WIDTH
    int
    range 64 1024
    default 400 if DRAFTLING_MODEL_WAVESHARE_RLCD42
    default 960 if DRAFTLING_MODEL_M5STACK_PAPERS3
    default 640 if DRAFTLING_MODEL_WAVESHARE_TOUCH_LCD_349
    default 480 if DRAFTLING_MODEL_JC3248W535
    default 320 if DRAFTLING_MODEL_LILYGO_TDISPLAY_S3
    help
        Display width in pixels (derived). Driven by the hardware-model
        choice. Must be a multiple of 8 for e-paper backends.

config DRAFTLING_DISPLAY_HEIGHT
    int
    range 64 1024
    default 300 if DRAFTLING_MODEL_WAVESHARE_RLCD42
    default 540 if DRAFTLING_MODEL_M5STACK_PAPERS3
    default 172 if DRAFTLING_MODEL_WAVESHARE_TOUCH_LCD_349
    default 320 if DRAFTLING_MODEL_JC3248W535
    default 170 if DRAFTLING_MODEL_LILYGO_TDISPLAY_S3
    help
        Display height in pixels (derived). Driven by the hardware-model
        choice.

choice DRAFTLING_DISPLAY_ROTATE
    prompt "Display rotation angle"
    default DRAFTLING_DISPLAY_ROTATE_0
    help
        Rotation angle for the display in degrees.

config DRAFTLING_DISPLAY_ROTATE_0
    bool "0 degrees (no rotation)"

config DRAFTLING_DISPLAY_ROTATE_90
    bool "90 degrees"

config DRAFTLING_DISPLAY_ROTATE_180
    bool "180 degrees"

config DRAFTLING_DISPLAY_ROTATE_270
    bool "270 degrees"

endchoice

config DRAFTLING_DISPLAY_ROTATE_ANGLE
    int
    default 0 if DRAFTLING_DISPLAY_ROTATE_0
    default 90 if DRAFTLING_DISPLAY_ROTATE_90
    default 180 if DRAFTLING_DISPLAY_ROTATE_180
    default 270 if DRAFTLING_DISPLAY_ROTATE_270

# DRAFTLING_DISPLAY_SCALE -- logical pixel size in physical panel
# pixels. Non-prompted derived int so the per-board default tracks
# the hardware-model choice automatically (no stickiness in
# sdkconfig). Override via sdkconfig.defaults if you need a value
# other than the per-board default.
#
# Every logical LVGL pixel is rendered as SCALE x SCALE physical
# panel pixels via nearest-neighbor expansion in the display
# backend. The editor and LVGL canvas operate in logical
# coordinates (panel size divided by SCALE); only the display
# backend scales up when pushing to the panel. Larger values give
# bigger text at the cost of less screen real estate.
#
# Defaults: 2 for the M5Stack PaperS3 (whose 540x960 panel is
# dense enough that 1:1 Greybeard text is uncomfortably small),
# 1 everywhere else (one LVGL pixel == one panel pixel).
# Currently only the M5Stack PaperS3, JC3248W535 and T-Display-S3
# backends implement the up-scaling; on the RLCD backend SCALE > 1
# has no visible effect.
config DRAFTLING_DISPLAY_SCALE
    int
    range 1 8
    default 2 if DRAFTLING_MODEL_M5STACK_PAPERS3
    default 1

config DRAFTLING_EPD_FULL_REFRESH_INTERVAL
    int "E-paper full-refresh interval (partial updates between full refreshes)"
    depends on DRAFTLING_DISPLAY_EPD
    range 1 1000
    default 30
    help
        How many partial refreshes the e-paper driver performs before it
        forces a full refresh to clear residual ghosting. Lower values
        give cleaner pixels at the cost of more frequent slow (3-5 s)
        full refreshes; higher values keep the UI snappy but let
        ghosting accumulate. The default of 30 is a reasonable balance
        for a Markdown editor; the M5Stack PaperS3 backend uses the
        single-pulse epd_fast waveform for partial refreshes, which is
        faster than the older two-pass epd_text but accumulates
        ghosting slightly more quickly.

config DRAFTLING_EPD_BLACK_BACKGROUND
    bool "Black background (white text on black)"
    depends on DRAFTLING_DISPLAY_EPD
    default n
    help
        When enabled, the editor renders white text on a black
        background instead of the default black text on a white
        background. Applies to the editor, file browser, menu, settings
        and all overlay dialogs. Selection and active-row highlights
        are inverted accordingly (they become black-on-white).

        Available only on e-paper boards. The screen is still wiped to
        white before deep sleep regardless of this setting, so the
        panel is left in a clean state while the MCU is asleep.

menu "LilyGO T-Display-S3 external SD card"
    depends on DRAFTLING_MODEL_LILYGO_TDISPLAY_S3

comment "There is no on-board MicroSD slot on the T-Display-S3."
comment "Wire an external SD module to a free SPI bus and set its pins below."
comment "Set MOSI / MISO / SCK / CS to -1 to disable SD card support."

config DRAFTLING_LILYGO_SD_MOSI_PIN
    int "SD card MOSI / DI GPIO"
    range -1 48
    default 11
    help
        GPIO connected to the external SD card module's MOSI (DI) pin.
        Set to -1 to disable SD support entirely.

config DRAFTLING_LILYGO_SD_MISO_PIN
    int "SD card MISO / DO GPIO"
    range -1 48
    default 13
    help
        GPIO connected to the external SD card module's MISO (DO) pin.

config DRAFTLING_LILYGO_SD_SCK_PIN
    int "SD card SCK / CLK GPIO"
    range -1 48
    default 12
    help
        GPIO connected to the external SD card module's SCK (CLK) pin.

config DRAFTLING_LILYGO_SD_CS_PIN
    int "SD card CS / SS GPIO"
    range -1 48
    default 10
    help
        GPIO connected to the external SD card module's CS (chip select)
        pin.

endmenu

config DRAFTLING_NO_KEYBOARD_SLEEP_SEC
    int "Deep-sleep timeout when no keyboard connects (s)"
    range 0 3600
    default 180
    help
        If no Bluetooth keyboard connects within this many seconds
        after boot, the device enters deep sleep to conserve battery.
        Useful when the device is powered on accidentally or the
        previously-paired keyboard is unavailable.

        Set to 0 to disable -- the device will then keep scanning
        indefinitely. The countdown is cancelled the first time a
        keyboard connects; after that the regular inactivity timeout
        (settable from the editor's F1 menu and persisted in NVS)
        takes over.

        Default is 180 seconds (3 minutes).


endmenu
```
