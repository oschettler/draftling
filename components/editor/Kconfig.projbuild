## sdkconfig.defaults
```kconfig
CONFIG_PARTITION_TABLE_CUSTOM=y
CONFIG_ESPTOOLPY_FLASHSIZE_16MB=y

# FreeRTOS
CONFIG_FREERTOS_HZ=1000

# FATFS for SD card
CONFIG_FATFS_LFN_HEAP=y
CONFIG_FATFS_MAX_LFN=255

# HTTP client
CONFIG_ESP_HTTP_CLIENT_ENABLE_HTTPS=y

# TLS
CONFIG_MBEDTLS_EXTERNAL_MEM_ALLOC=y

# LVGL fonts
CONFIG_LV_FONT_MONTSERRAT_10=y
CONFIG_LV_FONT_MONTSERRAT_12=y
CONFIG_LV_FONT_MONTSERRAT_14=y
CONFIG_LV_FONT_MONTSERRAT_16=y
CONFIG_LV_FONT_MONTSERRAT_18=y

# Compiler
CONFIG_COMPILER_OPTIMIZATION_PERF=y

# Bluetooth (BLE only -- ESP32-S3 has no Classic BT support)
CONFIG_BT_ENABLED=y
CONFIG_BT_BLUEDROID_ENABLED=y
CONFIG_BT_GATTC_ENABLE=y
CONFIG_BT_BLE_42_FEATURES_SUPPORTED=y
CONFIG_BT_BLE_SMP_ENABLE=y
```

## sdkconfig.defaults.esp32p4
```kconfig
# ESP32-P4-specific defaults
# Applied automatically when: idf.py set-target esp32p4
#
# Currently the only ESP32-P4 board supported is the M5Stack Tab5,
# which uses the upstream espressif/m5stack_tab5 BSP for all panel,
# touch, MIPI-DSI PHY, I/O expander and audio-codec bring-up.

CONFIG_ESPTOOLPY_FLASHMODE_QIO=y
CONFIG_ESPTOOLPY_FLASHSIZE_16MB=y

# PSRAM -- Tab5 carries 32 MB HEX-mode PSRAM (200 MHz). The MIPI-DSI
# DPI panel framebuffer (1280 * 720 * 2 = ~1.8 MB) and our LVGL
# rendering buffers must all live in PSRAM; internal SRAM on the
# ESP32-P4 is reserved for DMA descriptors and time-critical code.
CONFIG_SPIRAM=y
CONFIG_SPIRAM_MODE_HEX=y
CONFIG_SPIRAM_SPEED_200M=y
CONFIG_SPIRAM_ALLOW_STACK_EXTERNAL_MEMORY=y

# MIPI-DSI / DPI panel framebuffer
#
# The m5stack_tab5 BSP's bsp_display_new_with_handles() creates one
# CONFIG_BSP_LCD_DPI_BUFFER_NUMS framebuffer(s) internally. Draftling
# pushes pixels via esp_lcd_panel_draw_bitmap() into that framebuffer,
# so a single buffer is enough and saves ~1.8 MB of PSRAM.
CONFIG_BSP_LCD_DPI_BUFFER_NUMS=1

# Wi-Fi / Bluetooth on the ESP32-P4 are unavailable natively (no
# on-chip 2.4 GHz radio). Tab5 instead routes both through an on-board
# ESP32-C6 co-processor via the ESP-Hosted protocol over SDIO; we do
# not enable that here. The ble_keyboard component compiles to no-op
# stubs when CONFIG_BT_ENABLED is unset, and wifi_manager is only
# brought up lazily on the first Git-sync attempt so it stays inert.
# CONFIG_BT_ENABLED is intentionally left unset.

# The default ESP-IDF main task stack (3.5 KB) is too tight for the
# editor's call chains; match the ESP32-S3 build.
CONFIG_ESP_MAIN_TASK_STACK_SIZE=8192
```

## sdkconfig.defaults.esp32s3
```kconfig
# ESP32-S3-specific defaults
# Applied automatically when: idf.py set-target esp32s3

CONFIG_ESPTOOLPY_FLASHMODE_QIO=y
CONFIG_ESPTOOLPY_FLASHSIZE_16MB=y

# PSRAM
CONFIG_SPIRAM=y
CONFIG_SPIRAM_MODE_OCT=y
CONFIG_SPIRAM_SPEED_80M=y
CONFIG_SPIRAM_ALLOW_STACK_EXTERNAL_MEMORY=y
# Push WiFi/LwIP allocations into PSRAM where possible so they don't
# compete with Bluedroid for the limited internal heap.  This is
# required on the M5Stack PaperS3, which only has ~138 KB of internal
# heap free at boot (M5GFX/LovyanGFX statics consume the rest); without
# it esp_wifi_init() fails with ESP_ERR_NO_MEM after Bluedroid is up.
CONFIG_SPIRAM_TRY_ALLOCATE_WIFI_LWIP=y

# Bluetooth (BLE only -- ESP32-S3 has no Classic BT support)
CONFIG_BT_ENABLED=y
CONFIG_BT_BLUEDROID_ENABLED=y
CONFIG_BT_BLE_ENABLED=y
CONFIG_BT_GATTC_ENABLE=y
CONFIG_BT_BLE_42_FEATURES_SUPPORTED=y
CONFIG_BT_ALLOCATION_FROM_SPIRAM_FIRST=y
CONFIG_BT_BLE_SMP_ENABLE=y
CONFIG_BT_HID_HOST_ENABLED=y

# WiFi
# Static RX buffers are DMA-capable and must live in internal RAM.
# 10 (the IDF default) fits comfortably even on the M5Stack PaperS3
# where only ~138 KB of internal heap remain after M5GFX statics and
# Bluedroid bring-up; raising this to 16 makes esp_wifi_init() fail
# with ESP_ERR_NO_MEM on that board.
CONFIG_ESP_WIFI_STATIC_RX_BUFFER_NUM=10
CONFIG_ESP_WIFI_DYNAMIC_RX_BUFFER_NUM=32
```
