## components/editor/Kconfig.projbuild
```kconfig
menu "DRAFTLING Editor"

config DRAFTLING_EDITOR_BUFFER_SIZE_KB
    int "Editor document buffer size (KB)"
    range 32 4096
    default 256
    help
        Maximum size of a document (in kilobytes) that the editor can
        hold in memory. The gap buffer and the flattened text cache are
        each allocated at this size from PSRAM at startup, so the actual
        SPIRAM cost is roughly 2x this value. Files on disk larger than
        this limit cannot be opened (an error is shown in the status
        bar), and editing operations that would grow the document past
        the limit are refused with a "Buffer full" warning.

        Defaults to 256 KB. Increase only if you need to edit very
        large Markdown files and your target board has enough free
        PSRAM (the editor needs roughly 2x this value).

config DRAFTLING_KEY_QUEUE_LEN
    int "Key event queue length"
    range 4 256
    default 32
    help
        Size of the FreeRTOS queue that buffers key events from the BLE
        HID host task before they are drained by the LVGL GUI task.
        Larger values absorb bursts of keystrokes at the cost of a bit
        more RAM (each slot is a kb_event_t).

config DRAFTLING_KEY_DRAIN_PERIOD_MS
    int "Key event drain period (ms)"
    range 1 1000
    default 20
    help
        Period of the LVGL timer that drains the BLE key event queue on
        the GUI task. The default of 20 ms gives a 50 Hz poll rate.
        Lower values reduce input latency at the cost of more CPU
        wakeups; higher values save power but feel less responsive.

endmenu
```

## components/kb_layout/Kconfig.projbuild
```kconfig
menu "Keyboard Layouts"

config KB_LAYOUT_ENABLE_US
    bool "US-English (QWERTY)"
    default y
    help
        Enable the US-English QWERTY keyboard layout.

config KB_LAYOUT_ENABLE_UA
    bool "Ukrainian (Cyrillic)"
    default y
    help
        Enable the Ukrainian Cyrillic keyboard layout.

config KB_LAYOUT_ENABLE_DE
    bool "German (QWERTZ)"
    default n
    help
        Enable the German QWERTZ keyboard layout with umlauts.

config KB_LAYOUT_ENABLE_FR
    bool "French (AZERTY)"
    default n
    help
        Enable the French AZERTY keyboard layout with accents.

config KB_LAYOUT_ENABLE_KO
    bool "Korean (Dubeolsik)"
    default n
    help
        Enable the Korean Dubeolsik keyboard layout.
        Maps keys to Hangul Jamo characters.

config KB_LAYOUT_ENABLE_JA
    bool "Japanese (Kana)"
    default n
    help
        Enable the Japanese Kana keyboard layout.
        Maps keys to Hiragana characters (JIS kana input).

config KB_LAYOUT_ENABLE_ZH
    bool "Chinese (Zhuyin/Bopomofo)"
    default n
    help
        Enable the Chinese Zhuyin (Bopomofo) keyboard layout.
        Maps keys to Bopomofo phonetic symbols.

endmenu
```
